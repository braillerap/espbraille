## main/Kconfig.projbuild
```kconfig
menu "ESPBraille WIFI Configuration"

    config ESP_WIFI_SSID
        string "SoftAP SSID"
        default "esp32_ssid"
        help
            SSID (network name) to set up the softAP with.

    config ESP_WIFI_PASSWORD
        string "SoftAP Password"
        default "esp32_pwd"
        help
            WiFi password (WPA or WPA2) for the example to use for the softAP.

    config ESP_MAX_STA_CONN
        int "Maximal STA connections"
        default 4
        help
            Max number of the STA connects to AP.

    config ESP_WIFI_MODE
        int "Wifi mode"
        default 0
        help
            0 = Wifi as Access Point (AP), 1 Wifi as STATION (STA).            
endmenu
```

## sdkconfig.defaults
```kconfig
CONFIG_HTTPD_MAX_REQ_HDR_LEN=1024
CONFIG_LWIP_MAX_SOCKETS=16


CONFIG_ESP_WIFI_SSID="braillerap"
CONFIG_ESP_WIFI_PASSWORD="12345678"
CONFIG_ESP_MAX_STA_CONN=2
CONFIG_ESP_WIFI_MODE = 1
```
